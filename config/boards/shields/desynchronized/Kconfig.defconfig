## config/boards/shields/desynchronized/Kconfig.defconfig
```kconfig
if SHIELD_TRACKBALL

config ZMK_KEYBOARD_NAME
	default "trackball"

config SPI
	default y

config ZMK_SPLIT
	default n

config ZMK_USB
	default y


endif
```

## config/boards/shields/trackball/Kconfig.defconfig
```kconfig
if SHIELD_TRACKBALL

config ZMK_KEYBOARD_NAME
	default "trackball"

config SPI
	default y


endif
```

## config/west.yml
```yaml
manifest:
  remotes:
    - name: zmk
      url-base: https://github.com/josishmail
  projects:
    - name: zmk
      remote: zmk
      revision: ptdevice-refactor
      import: app/west.yml
  self:
    path: config
```
